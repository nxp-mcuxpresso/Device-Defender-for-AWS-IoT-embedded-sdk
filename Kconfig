## Kconfig
```kconfig
#
# Copyright 2024 NXP
#
# SPDX-License-Identifier: MIT
#


menu "device-defender"
    config MCUX_COMPONENT_middleware.aws_iot.device_defender
        bool "Component middleware.aws_iot.device_defender"
endmenu
```
